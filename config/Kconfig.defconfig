## config/Kconfig.defconfig
```kconfig
# Copyright (c)
# SPDX-License-Identifier: MIT

if BOARD_H3KB

config ZMK_KEYBOARD_NAME
    default "H3KB"

if USB_DEVICE_STACK

config USB_NRFX
    default y

endif # USB_DEVICE_STACK

config BT_CTLR
    default BT 

endif # BOARD_H3KB
```

## config/Kconfig.shield
```kconfig
# Copyright (c) 2020 The ZMK Contributors
# SPDX-License-Identifier: MIT

config SHIELD_H3KB
    def_bool $(shields_list_contains,h3kb)
```
